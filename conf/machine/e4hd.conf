## conf/machine/e4hd.conf
```bitbake
#@TYPE: Machine
#@NAME: Axas
#@DESCRIPTION: Machine configuration for the Axas E4HD

IMAGEDIR ?= "e4hd"

PREFERRED_VERSION_linux-${MACHINE} = "4.0.1"

MKUBIFS_ARGS = "-m 2048 -e 126976 -c 8192"
UBINIZE_ARGS = "-m 2048 -p 128KiB"

MACHINE_FEATURES += "dvb-c blindscan-dvbc blindscan-dvbs"

CHIPSET = "bcm7362"

require conf/machine/include/axas.inc
```
